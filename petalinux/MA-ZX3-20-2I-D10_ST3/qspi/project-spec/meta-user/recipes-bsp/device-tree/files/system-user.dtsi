/include/ "system-conf.dtsi"
/ {
	model = "Enclustra MA-ZX3-20-2I-D10 SOM";
};
#include "zynq_enclustra_common.dtsi"
#include "zynq_enclustra_mars_st3.dtsi"
#include "zynq_enclustra_mars_zx3.dtsi"
#include "zynq_enclustra_nand_parts.dtsi"
